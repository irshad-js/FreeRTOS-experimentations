# D2522AA register map
Vendor: Dialog; Series: D2522AA; File version: 1.2
CPU: CM0 r1p0, little endian, MPU, FPU, 3 interrupt priority bits
Registers are 32-bit, read-write, reset 0x0 unless marked. A register's access mark holds for its fields unless they carry their own. Offsets are from the block's base; [hi:lo] are bit positions; {n}, {i} and the like mark numbered series; 'fields as' and 'values as' point back to an identical list.

## DW — DW registers
Base 0x30020000
0x00 AHB_DMA_PL1_REG reset 0xF — AHB-DMA layer priority level for RFTP (AHB DMA layer only)
  [3:0] AHB_DMA_PL1 — Arbitration priority for master RFPT. 0: lowest, 15: highest.
0x04 AHB_DMA_PL2_REG reset 0xE — AHB-DMA layer priority level for LCD (AHB DMA layer only)
  [3:0] AHB_DMA_PL2 — Arbitration priority for master LCD. 0: lowest, 15: highest.
0x08 AHB_DMA_PL3_REG reset 0xD — AHB-DMA layer Priority level for GEN-DMA (AHB DMA layer only)
  [3:0] AHB_DMA_PL3 — Arbitration priority for master GEN-DMA. 0: lowest, 15: highest.
0x0C AHB_DMA_PL4_REG reset 0xC — AHB-DMA layer Priority level for CRYPTO-DMA (AHB DMA layer only)
  [3:0] AHB_DMA_PL4 — Arbitration priority for master CRYPTO-DMA. 0: lowest, 15: highest.
0x48 AHB_DMA_DFLT_MASTER_REG — Default master ID number (AHB DMA layer only)
  [3:0] AHB_DMA_DFLT_MASTER — Default master ID number register. The default master is the master that is granted by the bus when no master has requested ownership. 0: Dummy master 1: RFPT 2: LCD 3: GEN-DMA 3: CRYPTO-DMA
0x4C AHB_DMA_WTEN_REG — Weighted-Token Arbitration Scheme Enable (AHB DMA layer only)
  [0] AHB_DMA_WTEN — Weighted-token arbitration scheme enable.
0x50 AHB_DMA_TCL_REG reset 0xFFFF — Master clock refresh period (AHB DMA layer only)
  [15:0] AHB_DMA_TCL — Master clock refresh period, counting clock cycles. An arbitration period is defined over this number of tokens. When a new arbitration period starts, the master counters are reloaded. Recommended value is the sum of the AHB_DMA_CCLMx_REG valuesplus 2 tokens for each master, i.e. plus 6.
0x54 AHB_DMA_CCLM1_REG reset 0xF — USB Master clock tokens (AHB DMA layer only)
  [15:0] AHB_DMA_CCLM — Number of tokens (counted in AHB clock cycles) that a master can use on the bus before it has to arbitrate on a bus master with low priority and having tokens. Masters with tokens remaining have priority over masters that have used all of their tokens. User should configure all the token values ensuring that the sum does not exceeds the total allocated number of tokens. If a value of zero is configured, then the bus is deemed to have infinite tokens and will always operate in the upper-tier of arbitration.
0x58 AHB_DMA_CCLM2_REG reset 0xF — GenDMA Master clock tokens (AHB DMA layer only)
  [15:0] AHB_DMA_CCLM — Refer to AHB_DMA_CCLM1_REG
0x5C AHB_DMA_CCLM3_REG reset 0xF — CRYPTO Master clock tokens (AHB DMA layer only)
  [15:0] AHB_DMA_CCLM — AHB_DMA_CCLM1_REG
0x60 AHB_DMA_CCLM4_REG reset 0xF — CRYPTO Master clock tokens (AHB DMA layer only)
  [15:0] AHB_DMA_CCLM — AHB_DMA_CCLM1_REG
0x90 AHB_DMA_VERSION_REG reset 0x3231332A (reset mask 0x7FFFFFFF) — Version ID (AHB DMA layer only)
  [31:0] AHB_DMA_VERSION ro

## PATCH — PATCH registers
Base 0x30090000
0x00 PATCH_VALID_REG — Validity Control Register
  [21:0] PATCH_VALID — Indicates which patch entry is valid. For example, when bit x is high it indicates that entry x is valid, i.e. the values of PATCH_ADDRx_REG / PATCH_DATAx_REG, are effective.
{0x20+8i} PATCH_ADDR{i}_REG reset 0x900000 (i=0..19) — Patch Address field
  [16:1] PATCH_ADDR_C — The value which will be compared with the address on the AHB. If a match occurs then it is considered as the base address of a function.
0xC0 PATCH_ADDR20_REG reset 0x900000 — Patch Address field
  [16:2] PATCH_ADDR_D — The value which will be compared with the address on the AHB. If a match occurs, the reading data bus willl be replaced by the value of the corresponding PATCH_DATAx_REG.
0xC4 PATCH_DATA20_REG (reset mask 0x7FFFFFFF) — Patch Data field
  [31:0] PATCH_DATA — This is the value which will be injected into the data bus if there is a match on the comparison of the address with the respective PATCH_ADDRx_REG
0xC8 PATCH_ADDR21_REG reset 0x900000 — Patch Address field
  fields as PATCH_ADDR20_REG
0xCC PATCH_DATA21_REG (reset mask 0x7FFFFFFF) — Patch Data field
  fields as PATCH_DATA20_REG
